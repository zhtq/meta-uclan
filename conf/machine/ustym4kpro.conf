## conf/machine/ustym4kpro.conf
```bitbake
#@TYPE: Machine
#@NAME: ustym4kpro
#@DESCRIPTION: Machine configuration for the ustym4kpro

EXTRA_OECONF_append_pn-enigma2 = "--with-lcddev=/dev/null --with-alphablendingacceleration=always --with-blitaccelerationthreshold=250  --with-fillaccelerationthreshold=190000"

MACHINE_FEATURES += " textlcd 7segment blindscan dvb-c hisil mali transcoding emmc HDMI AV_JACK"
OPENPLI_FEATURES += " qtplugins"
DISTRO_FEATURES_remove = "x11 wayland"

CHIPSET = "Hi3798Mv200"

require conf/machine/include/uclan-hisi.inc

BLINDSCAN_BINARY = "uclan-blindscan"

RCNAME = "uclan"

BOX_BRAND = "uclan"

SOC_FAMILY = "hisi3798mv200"

MTD_KERNEL = "mmcblk0p12"
MTD_ROOTFS = "mmcblk0p16"

KERNEL_FILE = "kernel.bin"
ROOTFS_FILE = "rootfs.tar.bz2"
MTD_BLACK  = "mmcblk0"
```
